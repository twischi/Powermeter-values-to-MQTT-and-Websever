## components/Modbus_UART_RTU/Kconfig.projbuild
```kconfig
menu "My Modbus UART/Serial RTU Config"

    config MY_MB_UART_PORT_NUM
        int "UART port number"
        range 0 2 if IDF_TARGET_ESP32S3 || IDF_TARGET_ESP32S2 || IDF_TARGET_ESP32
        range 0 1 if IDF_TARGET_ESP32H2
        default 2 if IDF_TARGET_ESP32S3
        default 2 if IDF_TARGET_ESP32
        default 1 if IDF_TARGET_ESP32H2
        help
            UART communication port number for Modbus example.
            Check the Datasheet of your board or used chip to select the correct UART port.

    config MY_MB_UART_BAUD_RATE
        int "UART communication speed"
        range 1200 115200
        default 19200
        help
            UART communication speed for Modbus example.

    config MY_MB_UART_RXD
        int "UART RXD pin number"
        range 0 34 if IDF_TARGET_ESP32
        range 0 23 if IDF_TARGET_ESP32C6
        range 0 56 if IDF_TARGET_ESP32P4
        range 0 46 if IDF_TARGET_ESP32S2
        range 0 19 if IDF_TARGET_ESP32C3
        range 0 20 if IDF_TARGET_ESP32C2
        range 0 46 if IDF_TARGET_ESP32S3
        range 0 11 if IDF_TARGET_ESP32H2
        default 22 if IDF_TARGET_ESP32C6 || IDF_TARGET_ESP32P4
        default 8 if  IDF_TARGET_ESP32C3 || IDF_TARGET_ESP32C2
        default 18 if IDF_TARGET_ESP32S2 || IDF_TARGET_ESP32S3
        default 11 if IDF_TARGET_ESP32H2
        default 16 if IDF_TARGET_ESP32
        help
            GPIO number for UART RX pin. See UART documentation for more information
            about available pin numbers for UART.

    config MY_MB_UART_TXD
        int "UART TXD pin number"
        range 0 34 if IDF_TARGET_ESP32
        range 0 23 if IDF_TARGET_ESP32C6
        range 0 56 if IDF_TARGET_ESP32P4
        range 0 46 if IDF_TARGET_ESP32S2
        range 0 46 if IDF_TARGET_ESP32S3
        range 0 19 if IDF_TARGET_ESP32C3
        range 0 20 if IDF_TARGET_ESP32C2
        range 0 11 if IDF_TARGET_ESP32H2
        default 23 if IDF_TARGET_ESP32C6 || IDF_TARGET_ESP32P4
        default 9 if  IDF_TARGET_ESP32C3 || IDF_TARGET_ESP32C2
        default 17 if IDF_TARGET_ESP32S2 || IDF_TARGET_ESP32S3
        default 10 if IDF_TARGET_ESP32H2
        default 17 if IDF_TARGET_ESP32
        help
            GPIO number for UART TX pin. See UART documentation for more information
            about available pin numbers for UART.

    config MY_MB_REGISTER_REPONSE_TIMEOUT
        int "Register read/write response timeout in ms"
        range 10 10000
        default 200
        help
            Timeout for reading registers in milliseconds. Can be reduced to to for testing purposes.
            Default value is 200 ms, which is 0.2 second.
            Recommended value is between 1000 and 5000 ms.
    config MY_MB_READ_REGS_ONCE_WHEN_DESC_SET
        bool "Read all Registers ONCE after Descriptors was set" 
        default n
        help
            Read all Registers ONCE after Descriptors was set. This is useful for
            testing purposes, but not recommended for production code.

    config MY_MB_CYCLE_TIME_MS
        int "What should by the cycle time in ms?"
        range 300 60000 
        default 2000
        help
            Choose the cycle-time for reading your definded Modbus-Registers.
            Time in milliseconds, should not be lower than time needed
            for reading ALL your defined registers.

choice MY_MB_LOG_LEVEL
    prompt "Set Log Level for Modbus UART/Serial RTU Client"
    default MY_MB_LOG_LEVEL_INFO
    help
        Select the log verbosity for 'Modbus_UART_RTU'-commponente.

    config MY_MB_LOG_LEVEL_NONE
        bool "ESP_LOG_NONE"
    config MY_MB_LOG_LEVEL_ERROR
        bool "ESP_LOG_ERROR"
    config MY_MB_LOG_LEVEL_WARN
        bool "ESP_LOG_WARN"
    config MY_MB_LOG_LEVEL_INFO
        bool "ESP_LOG_INFO"
    config MY_MB_LOG_LEVEL_DEBUG
        bool "ESP_LOG_DEBUG"
    config MY_MB_LOG_LEVEL_VERBOSE
        bool "ESP_LOG_VERBOSE"
endchoice

config MY_MB_LOG_LEVEL
    int
    default 0 if MY_MB_LOG_LEVEL_NONE
    default 1 if MY_MB_LOG_LEVEL_ERROR
    default 2 if MY_MB_LOG_LEVEL_WARN
    default 3 if MY_MB_LOG_LEVEL_INFO
    default 4 if MY_MB_LOG_LEVEL_DEBUG
    default 5 if MY_MB_LOG_LEVEL_VERBOSE

endmenu
```

## components/NTPSync_and_localTZ/Kconfig.projbuild
```kconfig
menu "My Time Sync Configuration"

    config MY_SNTP_TIME_SERVER
        string "SNTP server name"
        default "europe.pool.ntp.org"
        help
            Hostname of the SNTP server used for sync.

    config MY_SNTP_TIME_ZONE
        string "Time zone"
        default "CET-1CEST,M3.5.0,M10.5.0/3"
        help
            Time zone in the format to be used. Default is for Central European Time.

choice MY_SNTP_LOG_LEVEL
    prompt "Set Log Level for Time Sync"
    default MY_SNTP_LOG_LEVEL_INFO
    help
        Select the log verbosity for 'NTPSync_and_localTZ'-commponente.

    config MY_SNTP_LOG_LEVEL_NONE
        bool "ESP_LOG_NONE"
    config MY_SNTP_LOG_LEVEL_ERROR
        bool "ESP_LOG_ERROR"
    config MY_SNTP_LOG_LEVEL_WARN
        bool "ESP_LOG_WARN"
    config MY_SNTP_LOG_LEVEL_INFO
        bool "ESP_LOG_INFO"
    config MY_SNTP_LOG_LEVEL_DEBUG
        bool "ESP_LOG_DEBUG"
    config MY_SNTP_LOG_LEVEL_VERBOSE
        bool "ESP_LOG_VERBOSE"
endchoice

config MY_SNTP_LOG_LEVEL
    int
    default 0 if MY_SNTP_LOG_LEVEL_NONE
    default 1 if MY_SNTP_LOG_LEVEL_ERROR
    default 2 if MY_SNTP_LOG_LEVEL_WARN
    default 3 if MY_SNTP_LOG_LEVEL_INFO
    default 4 if MY_SNTP_LOG_LEVEL_DEBUG
    default 5 if MY_SNTP_LOG_LEVEL_VERBOSE

endmenu
```

## components/OTA_mDNS/Kconfig.projbuild
```kconfig
menu "My OTA updates using mDNS-URLs Configuration"

   config OTA_MANUALLY_TRIGGER_ONLY
        bool "Trigger OTA updates manually only?"
        default n
        help
            With this option you can deactive the background Task behavior.
            If selected a Event (eg. from WebPage) triggers the OTA update process.  

    config OTA_CHECK_INTERVAL_SECS
        int "Intervall to check for update URL available (in sec)?"
        default 10
        range 1 7200
        depends on !OTA_MANUALLY_TRIGGER_ONLY
        help
            Set the intervall-timen in sec, where the OTA-Task checks if 
            a URL it lissten to is available. Then it will try to download the file
            and install it. The default is set to 10 seconds.

choice OTA_LOG_LEVEL
    prompt "Set Log Level for OTA updates"
    default OTA_LOG_LEVEL_INFO
    help
        Select the log verbosity for 'OTA_mDNS'-commponente.

    config OTA_LOG_LEVEL_NONE
        bool "ESP_LOG_NONE"
    config OTA_LOG_LEVEL_ERROR
        bool "ESP_LOG_ERROR"
    config OTA_LOG_LEVEL_WARN
        bool "ESP_LOG_WARN"
    config OTA_LOG_LEVEL_INFO
        bool "ESP_LOG_INFO"
    config OTA_LOG_LEVEL_DEBUG
        bool "ESP_LOG_DEBUG"
    config OTA_LOG_LEVEL_VERBOSE
        bool "ESP_LOG_VERBOSE"
endchoice

config OTA_LOG_LEVEL
    int
    default 0 if OTA_LOG_LEVEL_NONE
    default 1 if OTA_LOG_LEVEL_ERROR
    default 2 if OTA_LOG_LEVEL_WARN
    default 3 if OTA_LOG_LEVEL_INFO
    default 4 if OTA_LOG_LEVEL_DEBUG
    default 5 if OTA_LOG_LEVEL_VERBOSE
    
endmenu
```

## components/async_httpd_helper/Kconfig.projbuild
```kconfig
menu "My async HTTPD Helper (Worker Tasks) Configuration"

    config ASYNC_WORKER_MAX_HTTPD_REQUESTS
        int "Max async Requests (Worker Tasks) needed?"
        default 2
        range 1 10
        help
            The maximum number of simultaneous async requests that the web server will handle.
            To limit the number of resouces that are allocated, set this to a needed number.
            As of now the uppper limt is set to 10.

    config ASYNC_WORKER_TASK_PRIORITY
        int "What priority should the async worker tasks have?"
        default 5
        range 1 10
        help
            Set the priorities of the Worker-Task that will be created.

    config ASYNC_WORKER_TASK_STACK_SIZE_KB
        int "How much stack size (in KB) should EACH async worker tasks have?"
        default 4
        range 1 10
        help
            Adjust the stack size of the worker tasks that will be created.
            2 KB is sufficent in most cases.

choice ASYNC_WORKER_LOG_LEVEL
    prompt "Set Log Level for async HTTPD Helper"
    default ASYNC_WORKER_LOG_LEVEL_INFO
    help
        Select the log verbosity for 'async_httpd_helper'-commponente.

    config ASYNC_WORKER_LOG_LEVEL_NONE
        bool "ESP_LOG_NONE"
    config ASYNC_WORKER_LOG_LEVEL_ERROR
        bool "ESP_LOG_ERROR"
    config ASYNC_WORKER_LOG_LEVEL_WARN
        bool "ESP_LOG_WARN"
    config ASYNC_WORKER_LOG_LEVEL_INFO
        bool "ESP_LOG_INFO"
    config ASYNC_WORKER_LOG_LEVEL_DEBUG
        bool "ESP_LOG_DEBUG"
    config ASYNC_WORKER_LOG_LEVEL_VERBOSE
        bool "ESP_LOG_VERBOSE"
endchoice

config ASYNC_WORKER_LOG_LEVEL
    int
    default 0 if ASYNC_WORKER_LOG_LEVEL_NONE
    default 1 if ASYNC_WORKER_LOG_LEVEL_ERROR
    default 2 if ASYNC_WORKER_LOG_LEVEL_WARN
    default 3 if ASYNC_WORKER_LOG_LEVEL_INFO
    default 4 if ASYNC_WORKER_LOG_LEVEL_DEBUG
    default 5 if ASYNC_WORKER_LOG_LEVEL_VERBOSE

endmenu
```

## components/myMQTT/Kconfig.projbuild
```kconfig
menu "My MQTT Config"

    config MY_MQTT_BROKER_URL
        string "Broker URL"
        default "mqtt://192.168.1.66"
        help
            Put in the URL of the MQTT broker you want to connect to
            This is usually in the form of mqtt://<ip_address> or mqtts://<ip_address>

    config MY_MQTT_ROOT_TOPIC
        string "Root of MQTT Topic"
        default "Power-Meter"
        help
            Set a root topic for all MQTT messages to be published
            This ensures that messages can more easily be found in the message structure

    config MY_MQTT_RETAIN_DEFAULT
        int "Default to be Retained when when sending messages"
        default 1
        range 0 1
        help
            Set a DEFAULT if at message should be retained of not
            - 0 = Do not retain
            - 1 = Retain message

    config MY_MQTT_QOS_DEFAULT
        int "Default Quality of Service (QoS) when sending messages"
        default 1
        range 0 2
        help
            Set a DEFAULT QoS = Quality of Service Level to send MQTT messages
            - 0 = At Most Once
            - 1 = At Least Once
            - 2 = Exactly Once

    config MY_MQTT_KEEP_ALIVE
        int "Keep Alive time in sec for MQTT Client"
        default 120
        range 10 300
        help
            Set a Keep Alive time in seconds for the MQTT client. 

    config MY_MQTT_SEND_TEST_MESSAGE
        bool "Send a Test message for testing purposes"
        default n
        help
            Send a test message to the MQTT broker for testing purposes
            This is usually used to check if the connection to the broker is working  

    config MY_MQTT_SUBSCRIBE_TESTING
        bool "Suscribe to a topic for testing purposes"
        default n
        help
            Subscribe to a topic for testing purposes  
    
    config MY_MQTT_TOPIC_TO_SUBSCRIBE
        string "Topic to subscribe"
        default "Power-Meter/MEA/Power-Total"
        depends on MY_MQTT_SUBSCRIBE_TESTING
        help
            Set a topic to subscribe to for testing purposes

choice MY_MQTT_LOG_LEVEL
    prompt "Set Log Level for MQTT Client"
    default MY_MQTT_LOG_LEVEL_INFO
    help
        Select the log verbosity for 'myMQTT'-commponente.

    config MY_MQTT_LOG_LEVEL_NONE
        bool "ESP_LOG_NONE"
    config MY_MQTT_LOG_LEVEL_ERROR
        bool "ESP_LOG_ERROR"
    config MY_MQTT_LOG_LEVEL_WARN
        bool "ESP_LOG_WARN"
    config MY_MQTT_LOG_LEVEL_INFO
        bool "ESP_LOG_INFO"
    config MY_MQTT_LOG_LEVEL_DEBUG
        bool "ESP_LOG_DEBUG"
    config MY_MQTT_LOG_LEVEL_VERBOSE
        bool "ESP_LOG_VERBOSE"
endchoice

config MY_MQTT_LOG_LEVEL
    int
    default 0 if MY_MQTT_LOG_LEVEL_NONE
    default 1 if MY_MQTT_LOG_LEVEL_ERROR
    default 2 if MY_MQTT_LOG_LEVEL_WARN
    default 3 if MY_MQTT_LOG_LEVEL_INFO
    default 4 if MY_MQTT_LOG_LEVEL_DEBUG
    default 5 if MY_MQTT_LOG_LEVEL_VERBOSE

endmenu
```
