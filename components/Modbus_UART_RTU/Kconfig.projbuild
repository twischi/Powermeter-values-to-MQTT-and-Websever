## components/xlan_connection/Kconfig.projbuild
```kconfig
menu "My xLAN (ETHERNET/WiFi) Config with Hostname"

    config XLAN_USE_ETH
        bool "Use Ethernet for LAN connection"
        default y if ETHERNET_INTERNAL_SUPPORT || ETHERNET_SPI_SUPPORT
        default n
        help
            Select to use Ethernet as network interface.

    comment "Use 'Ethernet Configuration' to make settings"
        depends on XLAN_USE_ETH

    config XLAN_USE_WIFI
        depends on SOC_WIFI_SUPPORTED
        bool "Use WiFi Station for LAN connection"
        default y
        help
            Select to use WiFi as network interface.

    config XLAN_WIFI_SSID
        string "WiFi SSID"
        default "myssid"
        depends on XLAN_USE_WIFI
        help
            SSID (network name) for the example to connect to.

    config XLAN_WIFI_PASSWORD
        string "WiFi Password"
        default "mypassword"
        depends on XLAN_USE_WIFI
        help
            WiFi password (WPA or WPA2) for the example to use.

    config XLAN_MAXIMUM_RETRY
        int "Maximum retry"
        default 5
        depends on XLAN_USE_WIFI
        help
            Set the Maximum retry to avoid station reconnecting to the AP unlimited when the AP is really
            inexistent.

    config XLAN_USE_OWN_HOSTNAME
        bool "Use own Hostname"
        default y
        help
            Enable this option to use your own hostname for LAN connection.
            If not enabled, the default hostname will be used.

    config XLAN_HOSTNAME
        string "Set Hostname"
        default "ESP32S3-xLAN" if IDF_TARGET_ESP32S3
        default "ESP32-xLAN"   if IDF_TARGET_ESP32
        default "ESP32H2-xLAN" if IDF_TARGET_ESP32H2
        default "ESP-xLAN"     # <--- fallback default for all other chips
        depends on XLAN_USE_OWN_HOSTNAME
        help
            Set the hostname for the xLAN connection.
            This hostname will be used for network identification.
            You can override this value in your application code if needed.

    config XLAN_USE_STATIC_IP_ADDR
        bool "Use Static IP Address"
        default y
        help
            Enable this option to use a static IP address instead of DHCP.

    config XLAN_STATIC_IP_ADDR
        string "Static IP Address"
        default "192.168.1.17"
        depends on XLAN_USE_STATIC_IP_ADDR
        help
            Set the static IP address for the LAN (WiFi or Ethernet) connection.

    config XLAN_STATIC_NETMASK_ADDR
        string "Static Netmask"
        default "255.255.255.0"
        depends on XLAN_USE_STATIC_IP_ADDR
        help
            Set the netmask for the static IP configuration.

    config XLAN_STATIC_GW_ADDR
        string "Static Gateway"
        default "192.168.1.1"
        depends on XLAN_USE_STATIC_IP_ADDR
        help
            Set the gateway for the static IP configuration.

    choice XLAN_STATIC_DNS_SERVER
        prompt "Choose DNS server"
        default XLAN_STATIC_DNS_AUTO
        help
            Select auto to make gateway address as DNS server or manual to input your DNS server
        config XLAN_STATIC_DNS_AUTO
            bool "Use gateway address as DNS server"
            help
                Set DNS server the same as gateway address

        config XLAN_STATIC_DNS_MANUAL
            bool "Set manual value as DNS server"
            help
                Set DNS server with you want
    endchoice

    config XLAN_STATIC_DNS_SERVER_MAIN
        string "Main DNS server address"
        default XLAN_STATIC_GW_ADDR
        depends on XLAN_STATIC_DNS_MANUAL
        help
            Set main DNS server address.
                        
    config XLAN_STATIC_DNS_SERVER_BACKUP
        string "Backup DNS server address"
        default XLAN_STATIC_GW_ADDR
        depends on XLAN_STATIC_DNS_MANUAL
        help
            Set backup DNS server address. It can be same with the main DNS server address or leave empty.

    config XLAN_STATIC_DNS_RESOLVE_TEST
        bool "Enable DNS resolve test"
        default y
        help
            Enable it and configure XLAN_STATIC_RESOLVE_DOMAIN to resolve DNS domain name

    config XLAN_STATIC_RESOLVE_DOMAIN
        string "Domain name to resolve"
        default "www.espressif.com"
        depends on XLAN_STATIC_DNS_RESOLVE_TEST
        help
            Set domain name for DNS test

    config XLAN_USE_PING_GATEWAY
        bool "Activate frequent PING to Gateway (check if LAN is alive)?"
        default y 
        help
            This option enables a periodic PING to the gateway to check if the LAN connection is alive.
            You can use this to react, e.g., by restarting ESP, WiFi, ect.

    config XLAN_PING_GATEWAY_INTERVAL_SEC
        int "Set the interval in seconds for PING to Gateway"
        default 20
        range 5 600
        depends on XLAN_USE_PING_GATEWAY
        help
            Set the interval in seconds for the PING to Gateway.
            This is the time between two PING requests to the gateway.

choice XLAN_LOG_LEVEL
    prompt "Set Log Level for xLAN Connection"
    default XLAN_LOG_LEVEL_INFO
    help
        Select the log verbosity for 'xlan-connection'-commponente.

    config XLAN_LOG_LEVEL_NONE
        bool "ESP_LOG_NONE"
    config XLAN_LOG_LEVEL_ERROR
        bool "ESP_LOG_ERROR"
    config XLAN_LOG_LEVEL_WARN
        bool "ESP_LOG_WARN"
    config XLAN_LOG_LEVEL_INFO
        bool "ESP_LOG_INFO"
    config XLAN_LOG_LEVEL_DEBUG
        bool "ESP_LOG_DEBUG"
    config XLAN_LOG_LEVEL_VERBOSE
        bool "ESP_LOG_VERBOSE"
endchoice

config XLAN_LOG_LEVEL
    int
    default 0 if XLAN_LOG_LEVEL_NONE
    default 1 if XLAN_LOG_LEVEL_ERROR
    default 2 if XLAN_LOG_LEVEL_WARN
    default 3 if XLAN_LOG_LEVEL_INFO
    default 4 if XLAN_LOG_LEVEL_DEBUG
    default 5 if XLAN_LOG_LEVEL_VERBOSE

endmenu
```

## components/xlan_connection/sdkconfig.defaults
```kconfig
CONFIG_ETHERNET_RX_TASK_STACK_SIZE=3072
CONFIG_ETHERNET_SPI_CLOCK_MHZ=25
CONFIG_ETHERNET_SPI_HOST=2
CONFIG_ETHERNET_SPI_SCLK_GPIO=9
CONFIG_ETHERNET_SPI_MOSI_GPIO=10
CONFIG_ETHERNET_SPI_MISO_GPIO=11
CONFIG_ETHERNET_SPI_CS0_GPIO=12
CONFIG_ETHERNET_SPI_INT0_GPIO=13
CONFIG_ETHERNET_SPI_PHY_RST0_GPIO=14
CONFIG_ETHERNET_BOARD_SPECIFIC_INIT_DEFAULT=y
```

## main/Kconfig.projbuild
```kconfig
menu "My Powermeter Logging Settings"

# WEBSERIAL
    config PRM_MAIN_WEBSERIAL_USE
        bool "Use Webserial to forward logging messages"
        default y 
        help
            Use Webserial for logging, ESP_LOGx Message will be forwarded
            to be displayed on Webserial (Web page).

    config PRM_MAIN_WEBSERIAL_QUEUE_SIZE
        int "Webserial Queue Size"
        default 75
        range 20 200
        help
            Set the size of the Webserial queue. This is the number of messages
            that can be queued for display on the Webserial page.
            Default is 75 messages.
        depends on PRM_MAIN_WEBSERIAL_USE

# 5. MAIN App common
choice PRM_MAIN_LOG_LEVEL
    prompt "Set Log Level for MAIN Powermeter-App"
    default PRM_MAIN_LOG_LEVEL_INFO
    help
        Select the log verbosity for 'main.c'.

    config PRM_MAIN_LOG_LEVEL_NONE
        bool "ESP_LOG_NONE"
    config PRM_MAIN_LOG_LEVEL_ERROR
        bool "ESP_LOG_ERROR"
    config PRM_MAIN_LOG_LEVEL_WARN
        bool "ESP_LOG_WARN"
    config PRM_MAIN_LOG_LEVEL_INFO
        bool "ESP_LOG_INFO"
    config PRM_MAIN_LOG_LEVEL_DEBUG
        bool "ESP_LOG_DEBUG"
    config PRM_MAIN_LOG_LEVEL_VERBOSE
        bool "ESP_LOG_VERBOSE"
endchoice

config PRM_MAIN_LOG_LEVEL
    int
    default 0 if PRM_MAIN_LOG_LEVEL_NONE
    default 1 if PRM_MAIN_LOG_LEVEL_ERROR
    default 2 if PRM_MAIN_LOG_LEVEL_WARN
    default 3 if PRM_MAIN_LOG_LEVEL_INFO
    default 4 if PRM_MAIN_LOG_LEVEL_DEBUG
    default 5 if PRM_MAIN_LOG_LEVEL_VERBOSE

# 5. WebServer
choice PRM_WEBSERVER_LOG_LEVEL
    prompt "Set Log Level for WEBSERVER of Powermeter"
    default PRM_WEBSERVER_LOG_LEVEL_INFO
    help
        Select the log verbosity for Webserver of Powermeter.

    config PRM_WEBSERVER_LOG_LEVEL_NONE
        bool "ESP_LOG_NONE"
    config PRM_WEBSERVER_LOG_LEVEL_ERROR
        bool "ESP_LOG_ERROR"
    config PRM_WEBSERVER_LOG_LEVEL_WARN
        bool "ESP_LOG_WARN"
    config PRM_WEBSERVER_LOG_LEVEL_INFO
        bool "ESP_LOG_INFO"
    config PRM_WEBSERVER_LOG_LEVEL_DEBUG
        bool "ESP_LOG_DEBUG"
    config PRM_WEBSERVER_LOG_LEVEL_VERBOSE
        bool "ESP_LOG_VERBOSE"
endchoice

config PRM_WEBSERVER_LOG_LEVEL
    int
    default 0 if PRM_WEBSERVER_LOG_LEVEL_NONE
    default 1 if PRM_WEBSERVER_LOG_LEVEL_ERROR
    default 2 if PRM_WEBSERVER_LOG_LEVEL_WARN
    default 3 if PRM_WEBSERVER_LOG_LEVEL_INFO
    default 4 if PRM_WEBSERVER_LOG_LEVEL_DEBUG
    default 5 if PRM_WEBSERVER_LOG_LEVEL_VERBOSE
    # _WEB_SVR:  Log-Level for Webserver (async)

# 5. HTTP Daemon
choice PRM_HTTPDAEMON_LOG_LEVEL
    prompt "Set Log Level for HTTP-DAEMON of Powermeter-Webserver"
    default PRM_HTTPDAEMON_LOG_LEVEL_INFO
    help
        Select the log verbosity for HTTP-Daemon of Powermeter-Webserver.

    config PRM_HTTPDAEMON_LOG_LEVEL_NONE
        bool "ESP_LOG_NONE"
    config PRM_HTTPDAEMON_LOG_LEVEL_ERROR
        bool "ESP_LOG_ERROR"
    config PRM_HTTPDAEMON_LOG_LEVEL_WARN
        bool "ESP_LOG_WARN"
    config PRM_HTTPDAEMON_LOG_LEVEL_INFO
        bool "ESP_LOG_INFO"
    config PRM_HTTPDAEMON_LOG_LEVEL_DEBUG
        bool "ESP_LOG_DEBUG"
    config PRM_HTTPDAEMON_LOG_LEVEL_VERBOSE
        bool "ESP_LOG_VERBOSE"
endchoice

config PRM_HTTPDAEMON_LOG_LEVEL
    int
    default 0 if PRM_HTTPDAEMON_LOG_LEVEL_NONE
    default 1 if PRM_HTTPDAEMON_LOG_LEVEL_ERROR
    default 2 if PRM_HTTPDAEMON_LOG_LEVEL_WARN
    default 3 if PRM_HTTPDAEMON_LOG_LEVEL_INFO
    default 4 if PRM_HTTPDAEMON_LOG_LEVEL_DEBUG
    default 5 if PRM_HTTPDAEMON_LOG_LEVEL_VERBOSE    
    # httpd:     Log-Level for ESP-IDF HTTPD

#  6. Establish Modbus RTU Connection
choice PRM_MODBUS_LOG_LEVEL
    prompt "Set Log Level for MOBUS communication"
    default PRM_MODBUS_LOG_LEVEL_INFO
    help
        Select the log verbosity for Modubus communication.

    config PRM_MODBUS_LOG_LEVEL_NONE
        bool "ESP_LOG_NONE"
    config PRM_MODBUS_LOG_LEVEL_ERROR
        bool "ESP_LOG_ERROR"
    config PRM_MODBUS_LOG_LEVEL_WARN
        bool "ESP_LOG_WARN"
    config PRM_MODBUS_LOG_LEVEL_INFO
        bool "ESP_LOG_INFO"
    config PRM_MODBUS_LOG_LEVEL_DEBUG
        bool "ESP_LOG_DEBUG"
    config PRM_MODBUS_LOG_LEVEL_VERBOSE
        bool "ESP_LOG_VERBOSE"
endchoice

config PRM_MODBUS_LOG_LEVEL
    int
    default 0 if PRM_MODBUS_LOG_LEVEL_NONE
    default 1 if PRM_MODBUS_LOG_LEVEL_ERROR
    default 2 if PRM_MODBUS_LOG_LEVEL_WARN
    default 3 if PRM_MODBUS_LOG_LEVEL_INFO
    default 4 if PRM_MODBUS_LOG_LEVEL_DEBUG
    default 5 if PRM_MODBUS_LOG_LEVEL_VERBOSE    
    # MB_R_REG:  Log-Level for frequent read of Modbus Registers
    # MQ_P_REG:  Log-Level for frequent read of Modbus Registers

#  8. Publish MQTT-Messages
choice PRM_MQTT_LEVEL
    prompt "Set Log Level for MQTT publish of values"
    default PRM_MQTT_LOG_LEVEL_INFO
    help
        Select the log verbosity for MQTT-Publish.

    config PRM_MQTT_LOG_LEVEL_NONE
        bool "ESP_LOG_NONE"
    config PRM_MQTT_LOG_LEVEL_ERROR
        bool "ESP_LOG_ERROR"
    config PRM_MQTT_LOG_LEVEL_WARN
        bool "ESP_LOG_WARN"
    config PRM_MQTT_LOG_LEVEL_INFO
        bool "ESP_LOG_INFO"
    config PPRM_MQTT_LOG_LEVEL_DEBUG
        bool "ESP_LOG_DEBUG"
    config PPRM_MQTT_LOG_LEVEL_VERBOSE
        bool "ESP_LOG_VERBOSE"
endchoice

config PRM_MQTT_LOG_LEVEL
    int
    default 0 if PRM_MQTT_LOG_LEVEL_NONE
    default 1 if PRM_MQTT_LOG_LEVEL_ERROR
    default 2 if PRM_MQTT_LOG_LEVEL_WARN
    default 3 if PRM_MQTT_LOG_LEVEL_INFO
    default 4 if PRM_MQTT_LOG_LEVEL_DEBUG
    default 5 if PRM_MQTT_LOG_LEVEL_VERBOSE        
    #  MQ_P_ESP:  Log-Level for publish of ESP-Values
    #  MQ_P_ESP:  Log-Level for publish of Common Infos
    
endmenu
```
